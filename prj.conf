## CMakeLists.txt
```
# SPDX-License-Identifier: Apache-2.0

cmake_minimum_required(VERSION 3.20.0)

###############################################################################################################
# here is the best place for adding mcuboot CONFIGs, as the root folder remains untouched
# only rsa-2048 key did work for my config, not clear why.
# folder with the custom key is added to project folder and defined below
# key generated via command in ncs/vX.X.X folder: python3 bootloader/mcuboot/scripts/imgtool.py keygen -t rsa-2048 -k priv.pem

set(mcuboot_CONFIG_BOOT_SIGNATURE_KEY_FILE \"${CMAKE_CURRENT_SOURCE_DIR}/custom_key_dir/OBSmini-rsa-2048.pem\")
set(mcuboot_CONFIG_DISABLE_FLASH_PATCH y)
###############################################################################################################

find_package(Zephyr REQUIRED HINTS $ENV{ZEPHYR_BASE})
project(OBSmini_ADC)

target_sources(app PRIVATE 
    src/main.c
    src/ble.c
    src/error_handling.c
    src/nfc.c
    src/pulse_generator.c
    src/saadc.c
    src/timer_and_ppi.c
    src/watchdog.c    
)
```

## prj.conf
```kconfig
# select n for production and CONFIG_LOG_DEFAULT_LEVEL=4 will crash
CONFIG_LOG=y
CONFIG_LOG_DEFAULT_LEVEL=3
#CONFIG_SERIAL=n

CONFIG_PM=y
CONFIG_EVENTS=y

CONFIG_NRFX_PPI=y
CONFIG_NRFX_SAADC=y
CONFIG_NRFX_TIMER1=y
CONFIG_NRFX_TIMER2=y
CONFIG_NRFX_PWM0=y
CONFIG_NRFX_WDT0=y

CONFIG_BT=y
CONFIG_BT_PERIPHERAL=y
CONFIG_BT_DEVICE_NAME="OBSmini"
CONFIG_BT_LL_SOFTDEVICE=y
CONFIG_BT_USER_PHY_UPDATE=y

CONFIG_NFC_T2T_NRFXLIB=y
CONFIG_NFC_NDEF=y
CONFIG_NFC_NDEF_MSG=y
CONFIG_NFC_NDEF_RECORD=y
CONFIG_NFC_NDEF_URI_REC=y
CONFIG_NFC_NDEF_LAUNCHAPP_MSG=y

#device firmware update - over the air (DFU OTA)
CONFIG_NCS_SAMPLE_MCUMGR_BT_OTA_DFU=y
CONFIG_BOOTLOADER_MCUBOOT=y
```

## src/main.c
```c
// This code is written for the OBSmini with the aim to visualize the recieved echo signals as measured by the nRF52833.
// The results can be used to tune limits/timings etc.
// 38.5mA (36mA from ultrasonic bursts + 2.5mA from CPU, BLE, OpAmps etc.) when connected and sampling with 15+1 pulses every 20ms
// 8µA when off (deep sleeping waiting for NFC)
//
// Most code comes from official examples:
// NFC/Powermanagement: nrf/samples/nfc/system_off
// SAADC/PPI: https://github.com/NordicPlayground/nRF52-ADC-examples/tree/master/nrfx_saadc_multi_channel_ppi
// BLE: webinar: Developing Bluetooth Low Energy products using nRF Connect SDK
// PWM: nRF5_SDKv17.0.2/examples/peripheral/pwm_driver
// DFU_OTA: https://developer.nordicsemi.com/nRF_Connect_SDK/doc/latest/nrf/working_with_nrf/nrf52/developing.html#fota-updates
// with DFU_OTA: the "merged.hex" is used to drag´n´drop flash and the "app_update.bin" is used for DFU.
// without DFU_OTA: the "zephyr.bin" is used to drag´n´drop flash (all these files are found in ...\myProjectFolder\build\zephyr)
// MCUBoot: https://developer.nordicsemi.com/nRF_Connect_SDK/doc/latest/nrf/app_dev/bootloaders_and_dfu/index.html
//		and https://github.com/hellesvik-nordic/samples_for_nrf_connect_sdk/tree/1111836cd720127c7f2b0dc0bec9f7ef496b8954/bootloader_samples
//
// missed ncs/zephyr pull requests which have to be added manually (should be obsolete in future):
// https://github.com/zephyrproject-rtos/zephyr/pull/57886/commits/15e7ab19fc0b8d51942c3cca5d1b13df0ebdbec0
// https://github.com/zephyrproject-rtos/zephyr/pull/56309/commits/2094e19a3c58297125c1289ea0ddec89db317f96

#include <zephyr/init.h>
#include <zephyr/kernel.h>
#include <zephyr/logging/log.h>
#include <zephyr/pm/pm.h>
#include <zephyr/pm/policy.h>

#include <hal/nrf_power.h>

#include "ble.h"
#include "error_handling.h"
#include "global_config.h"
#include "nfc.h"
#include "pulse_generator.h"
#include "saadc.h"
#include "timer_and_ppi.h"
#include "watchdog.h"

#define SAADC_EVENT_DONE BIT(0)

// forward declarations	------------------------------------------------------------------------------------------------------------------------
void ble_connected_handler(struct bt_conn *conn, uint8_t err);
void ble_disconnected_handler(struct bt_conn *conn, uint8_t reason);

struct bt_conn *current_ble_conn;
struct bt_conn_cb bluetooth_handlers = {
    .connected    = ble_connected_handler,
    .disconnected = ble_disconnected_handler};

// global variables	------------------------------------------------------------------------------------------------------------------------
bool ble_notifications_enabled      = false;
uint8_t measurements                = 1;
uint16_t ultrasonic_echo_time_left  = UINT16_MAX;
uint16_t ultrasonic_echo_time_right = UINT16_MAX;
uint16_t ultrasonic_echo_times_us[MAX_MEASUREMENTS];

// pre kernel initialization ------------------------------------------------------------------------------------------------------------------------
LOG_MODULE_REGISTER(main);
K_EVENT_DEFINE(saadc_done);

// Prevent deep sleep (system off) from being entered on long timeouts
// or `K_FOREVER` due to the default residency policy.
// This has to be done before anything tries to sleep, which means
// before the threading system starts up between PRE_KERNEL_2 and
// POST_KERNEL.  Do it at the start of PRE_KERNEL_2.
int prevent_system_off(void)
{
    pm_policy_state_lock_get(PM_STATE_SOFT_OFF, PM_ALL_SUBSTATES);
    return 0;
}
SYS_INIT(prevent_system_off, PRE_KERNEL_2, 0);

// if GPIO output voltage (REGOUT0) is still set to default '111' (1.8 volts) increase GPIO voltage to '100' (3.0 volts) to drive mosfets properly.
// it's in non-volatile register so we must use NVMC. Only bit flips from '1' to '0' are possible without debugger.
// this is copy paste from "zephyr/boards/arm/nrf52840dongle_nrf52840/board.c"
int set_REGOUT0_to_3V0(void)
{
    if ((nrf_power_mainregstatus_get(NRF_POWER) == NRF_POWER_MAINREGSTATUS_HIGH) &&
        ((NRF_UICR->REGOUT0 & UICR_REGOUT0_VOUT_Msk) == (UICR_REGOUT0_VOUT_DEFAULT << UICR_REGOUT0_VOUT_Pos)))
    {
        NRF_NVMC->CONFIG = NVMC_CONFIG_WEN_Wen << NVMC_CONFIG_WEN_Pos;
        while (NRF_NVMC->READY == NVMC_READY_READY_Busy)
        {
        }
        NRF_UICR->REGOUT0 = (NRF_UICR->REGOUT0 & ~((uint32_t)UICR_REGOUT0_VOUT_Msk)) | (UICR_REGOUT0_VOUT_3V0 << UICR_REGOUT0_VOUT_Pos);
        NRF_NVMC->CONFIG  = NVMC_CONFIG_WEN_Ren << NVMC_CONFIG_WEN_Pos;
        while (NRF_NVMC->READY == NVMC_READY_READY_Busy)
        {
        }
        /* a reset is required for changes to take effect */
        NVIC_SystemReset();
    }
    return 0;
}
SYS_INIT(set_REGOUT0_to_3V0, PRE_KERNEL_1, CONFIG_KERNEL_INIT_PRIORITY_DEFAULT);

// interrupt handlers ------------------------------------------------------------------------------------------------------------------------
void ble_connected_handler(struct bt_conn *conn, uint8_t err)
{
    if (err)
    {
        LOG_ERR("connection err: %d", err);
        return;
    }
    LOG_INF("Connected.");
    current_ble_conn = bt_conn_ref(conn);
}

void ble_disconnected_handler(struct bt_conn *conn, uint8_t reason)
{
    LOG_INF("Disconnected (reason: %d)", reason);
    if (current_ble_conn)
    {
        bt_conn_unref(current_ble_conn);
        current_ble_conn = NULL;
    }
}

void ble_notification_changed_handler(const struct bt_gatt_attr *attr, uint16_t value)
{
    ble_notifications_enabled = (value == BT_GATT_CCC_NOTIFY);
    LOG_INF("Notifications %s", ble_notifications_enabled ? "enabled" : "disabled");
    if (ble_notifications_enabled)
    {
        timer_start();
        saadc_sampling_start();
    }
}

void saadc_handler(nrfx_saadc_evt_t const *p_event)
{
    switch (p_event->type)
    {
    case NRFX_SAADC_EVT_LIMIT:
        if (p_event->data.limit.channel == LEFT_SENSOR)
        {
            nrfx_err = nrfx_saadc_limits_set(LEFT_SENSOR, INT16_MIN, INT16_MAX);
            NRFX_ERR_CHECK(nrfx_err, "setting SAADC comperator limits failed");
            ultrasonic_echo_time_left = get_echo_time_us();
        }
        else if (p_event->data.limit.channel == RIGHT_SENSOR)
        {
            nrfx_err = nrfx_saadc_limits_set(RIGHT_SENSOR, INT16_MIN, INT16_MAX);
            NRFX_ERR_CHECK(nrfx_err, "setting SAADC comperator limits failed");
            ultrasonic_echo_time_right = get_echo_time_us();
        }
        break;
    case NRFX_SAADC_EVT_DONE:
        timer_stop();
        saadc_sampling_stop(); // should be called in NRFX_SAADC_EVT_FINISHED, but that event was never generated,
                               // perhaps because one dimensional buffer was used instead of double buffer?
        k_event_set(&saadc_done, SAADC_EVENT_DONE);
        break;
    case NRFX_SAADC_EVT_BUF_REQ:
        saadc_buffer_set();
        break;
    default:
        LOG_INF("SAADC evt %d", p_event->type);
        break;
    }
}

void timer_handler(nrf_timer_event_t event_type, void *p_context)
{
    switch (event_type)
    {
        // set the echo signal receive signal limits corresponding to the time after the pulse
        // but check if a signal was already received to not accidentally detect a later signal
    case NRF_TIMER_EVENT_COMPARE1:
        nrfx_err = nrfx_saadc_limits_set(LEFT_SENSOR, INT16_MIN, SHORT_DISTANCE_LIMIT_HIGH);
        NRFX_ERR_CHECK(nrfx_err, "setting SAADC comperator limits failed");
        nrfx_err = nrfx_saadc_limits_set(RIGHT_SENSOR, INT16_MIN, SHORT_DISTANCE_LIMIT_HIGH);
        NRFX_ERR_CHECK(nrfx_err, "setting SAADC comperator limits failed");
        break;
    case NRF_TIMER_EVENT_COMPARE2:
        if (ultrasonic_echo_time_left == UINT16_MAX)
        {
            nrfx_err = nrfx_saadc_limits_set(LEFT_SENSOR, INT16_MIN, MEDIUM_DISTANCE_LIMIT_HIGH);
            NRFX_ERR_CHECK(nrfx_err, "setting SAADC comperator limits failed");
        }
        if (ultrasonic_echo_time_right == UINT16_MAX)
        {
            nrfx_err = nrfx_saadc_limits_set(RIGHT_SENSOR, INT16_MIN, MEDIUM_DISTANCE_LIMIT_HIGH);
            NRFX_ERR_CHECK(nrfx_err, "setting SAADC comperator limits failed");
        }
        break;
    case NRF_TIMER_EVENT_COMPARE3:
        if (ultrasonic_echo_time_left == UINT16_MAX)
        {
            nrfx_err = nrfx_saadc_limits_set(LEFT_SENSOR, INT16_MIN, LONG_DISTANCE_LIMIT_HIGH);
            NRFX_ERR_CHECK(nrfx_err, "setting SAADC comperator limits failed");
        }
        if (ultrasonic_echo_time_right == UINT16_MAX)
        {
            nrfx_err = nrfx_saadc_limits_set(RIGHT_SENSOR, INT16_MIN, LONG_DISTANCE_LIMIT_HIGH);
            NRFX_ERR_CHECK(nrfx_err, "setting SAADC comperator limits failed");
        }
        break;
    default:
        break;
    }
}

void nfc_handler(void *context,
                 nfc_t2t_event_t event,
                 const uint8_t *data,
                 size_t data_length)
{
    switch (event)
    {
    case NFC_T2T_EVENT_DATA_READ:
        nrf_gpio_pin_clear(RED_LED);
        break;
    case NFC_T2T_EVENT_FIELD_OFF:
        nrf_gpio_pin_set(RED_LED);
        break;
    default:
        break;
    }
}

void wdt_handler(void)
{
    // only two 32kHz ticks are left before WDT reset happens
    nrf_gpio_pin_set(OPAMPS_ON_OFF);
    nrf_gpio_pin_clear(RED_LED); // a short red blink can be seen before reset, if WDT is responsible
}

// functions ------------------------------------------------------------------------------------------------------------------------
void turn_opamps_on()
{
    // simply setting the pin is to much inrush current resulting in a SOC reset, so the OpAmps must be slowly toggled on
    k_msleep(100);
    for (int i = 0; i < 1000; i++)
    {
        nrf_gpio_pin_toggle(OPAMPS_ON_OFF);
    }
    nrf_gpio_pin_clear(OPAMPS_ON_OFF);
    k_msleep(100); // take a pause before and after turn on to stablize the LDO
}

void turn_system_off()
{
    LOG_INF("Entering system off. Approach a NFC reader to restart.");

    nrf_gpio_pin_set(BLUE_LED);
    nrf_gpio_pin_set(RED_LED);
    nrf_gpio_pin_set(OPAMPS_ON_OFF);

    // needed to finish turn off before system off
    k_msleep(1);

    // Above we disabled entry to deep sleep based on duration of
    // controlled delay.  Here we need to override that, then
    // force entry to deep sleep (system off) on any delay.
    pm_state_force(0, &(struct pm_state_info){PM_STATE_SOFT_OFF, 0, 0});

    // Going into sleep will actually go to system off mode, because we
    // forced it above.
    k_sleep(K_FOREVER);

    // k_sleep will never exit, so below two lines will never be executed
    // if system off was correct. On the other hand if someting gone wrong
    // we will see it on terminal and LED.
    nrf_gpio_pin_clear(BLUE_LED);
    LOG_ERR("ERROR: System off failed");
}

void main(void)
{
    uint32_t events;
    uint16_t system_off_counter = TIME_TO_SYSTEM_OFF_S;

    LOG_INF("Hello OBSmini! Config = %s", CONFIG_BOARD);

    nrf_gpio_cfg_output(BLUE_LED);
    nrf_gpio_pin_clear(BLUE_LED); // => ON

    nrf_gpio_cfg_output(RED_LED);
    nrf_gpio_pin_set(RED_LED); // => OFF

    nrf_gpio_cfg_output(OPAMPS_ON_OFF);
    nrf_gpio_pin_set(OPAMPS_ON_OFF); // => OFF

    watchdog_init(wdt_handler);
    saadc_init(saadc_handler);
    timer_and_ppi_init(timer_handler);
    nfc_init(nfc_handler);
    pulse_generator_init();
    ble_init(&bluetooth_handlers);

    turn_opamps_on();

    while (true)
    {
        while (ble_notifications_enabled)
        {
            events = k_event_wait(&saadc_done, SAADC_EVENT_DONE, false, K_MSEC(5000)); // this approach consumes 2.5mA vs 5mA when activly polling (without US-Trafos)
            if (events == 0)
            {
                error_handling();
                LOG_ERR("no SAADC converion done!");
            }
            else
            {
                nrf_gpio_pin_set(BLUE_LED);

                ultrasonic_echo_times_us[measurements] = ultrasonic_echo_time_left;
                ultrasonic_echo_time_left              = UINT16_MAX;
                ++measurements;
                ultrasonic_echo_times_us[measurements] = ultrasonic_echo_time_right;
                ultrasonic_echo_time_right             = UINT16_MAX;
                ++measurements;

                nrfx_err = nrfx_saadc_limits_set(LEFT_SENSOR, INT16_MIN, INT16_MAX);
                NRFX_ERR_CHECK(nrfx_err, "setting SAADC comperator limits failed");
                nrfx_err = nrfx_saadc_limits_set(RIGHT_SENSOR, INT16_MIN, INT16_MAX);
                NRFX_ERR_CHECK(nrfx_err, "setting SAADC comperator limits failed");

                if (measurements >= MAX_MEASUREMENTS)
                {
                    nrf_gpio_pin_clear(BLUE_LED);
                    LOG_INF("SAADC_send");
                    ultrasonic_echo_times_us[0] = get_battery_voltage_mV(saadc_handler);
                    measurements                = 1;
                    ble_send(current_ble_conn, ultrasonic_echo_times_us, sizeof(ultrasonic_echo_times_us));
                    watchdog_feed();
                }
                burst_ultrasonic_pulse_sequence();
                timer_start();
                saadc_sampling_start();

                k_event_clear(&saadc_done, SAADC_EVENT_DONE);
            }
        }

        if (current_ble_conn == NULL)
        {
            --system_off_counter;

            if (system_off_counter == 0)
            {
                turn_system_off();
            }
        }
        else
        {
            system_off_counter = TIME_TO_SYSTEM_OFF_S;
        }

        nrf_gpio_pin_toggle(BLUE_LED);
        watchdog_feed();
        k_msleep(1000);
    }
}
```

## src/ble.c
```c
#include "ble.h"

#define BLE_DEVICE_NAME     CONFIG_BT_DEVICE_NAME
#define BLE_DEVICE_NAME_LEN (sizeof(BLE_DEVICE_NAME) - 1)

LOG_MODULE_REGISTER(ble);

static const struct bt_data ad[] = {
    BT_DATA_BYTES(BT_DATA_FLAGS, (BT_LE_AD_GENERAL | BT_LE_AD_NO_BREDR)),
    BT_DATA(BT_DATA_NAME_COMPLETE, BLE_DEVICE_NAME, BLE_DEVICE_NAME_LEN)};

void ble_notification_changed_handler(const struct bt_gatt_attr *attr, uint16_t value);

BT_GATT_SERVICE_DEFINE(remote_srv,
                       BT_GATT_PRIMARY_SERVICE(BT_UUID_OBS_SERVICE),
                       BT_GATT_CHARACTERISTIC(BT_UUID_OBS_DISTANCES_CHRC,
                                              BT_GATT_CHRC_NOTIFY,
                                              BT_GATT_PERM_READ,
                                              NULL, NULL, NULL),
                       BT_GATT_CCC(ble_notification_changed_handler, BT_GATT_PERM_READ | BT_GATT_PERM_WRITE));

void ble_init(struct bt_conn_cb *bt_cb)
{
    LOG_INF("Initializing BLE...");

    bt_conn_cb_register(bt_cb);
    err = bt_enable(NULL);
    ERR_CHECK(err, "Cannot enable BLE!");
    err = bt_le_adv_start(BT_LE_ADV_CONN, ad, ARRAY_SIZE(ad), NULL, 0);
    ERR_CHECK(err, "Cannot start advertising");
}

void ble_send(struct bt_conn *ble_conn, int16_t *data_array, uint16_t data_array_length)
{
    int8_t ble_send_buffer[data_array_length];

    // https://devzone.nordicsemi.com/f/nordic-q-a/50415/sending-32-bit-of-data-over-ble-onto-nrf52832
    memcpy(ble_send_buffer, data_array, sizeof(ble_send_buffer));

    err = bt_gatt_notify(ble_conn, &remote_srv.attrs[2], ble_send_buffer, sizeof(ble_send_buffer));
    ERR_CHECK(err, "BLE notification failed");
}
```

## src/ble.h
```c
#ifndef BLE_H
#define BLE_H

#include "error_handling.h"
#include <zephyr/bluetooth/bluetooth.h>
#include <zephyr/bluetooth/gatt.h>
#include <zephyr/bluetooth/hci.h>
#include <zephyr/bluetooth/uuid.h>
#include <zephyr/logging/log.h>

#define BT_UUID_OBS_SERVICE_VAL        BT_UUID_128_ENCODE(0x24749e30, 0xa637, 0x4fd1, 0x9040, 0x5a1b76932cf2)
#define BT_UUID_OBS_SERVICE            BT_UUID_DECLARE_128(BT_UUID_OBS_SERVICE_VAL)
#define BT_UUID_OBS_DISTANCES_CHRC_VAL BT_UUID_128_ENCODE(0x24749e31, 0xa637, 0x4fd1, 0x9040, 0x5a1b76932cf2)
#define BT_UUID_OBS_DISTANCES_CHRC     BT_UUID_DECLARE_128(BT_UUID_OBS_DISTANCES_CHRC_VAL)

void ble_init(struct bt_conn_cb *bt_cb);
void ble_send(struct bt_conn *ble_conn, int16_t *data_array, uint16_t data_array_length);

#endif
```

## src/error_handling.c
```c
#include "error_handling.h"

int nrfx_err = NRFX_SUCCESS;
int err      = 0;

// TODO: perform reboot or similar
void error_handling(void)
{
    for (int i = 0; i < 5; i++)
    {
        nrf_gpio_pin_toggle(RED_LED);
        k_msleep(200);
    }
    nrf_gpio_pin_set(RED_LED);
}
```

## src/error_handling.h
```c
#ifndef ERROR_HANDLING_H
#define ERROR_HANDLING_H

#include "global_config.h"
#include <zephyr/kernel.h>
#include <zephyr/logging/log.h>

#define NRFX_ERR_CHECK(nrfx_err, msg)   \
    if (nrfx_err != NRFX_SUCCESS)       \
    {                                   \
        LOG_ERR(msg " - %d", nrfx_err); \
        error_handling();               \
    }
#define ERR_CHECK(err, msg)        \
    if (err)                       \
    {                              \
        LOG_ERR(msg " - %d", err); \
        error_handling();          \
    }

extern int nrfx_err;
extern int err;

void error_handling(void);

#endif
```

## src/global_config.h
```c
#ifndef GLOBAL_CONFIG_H
#define GLOBAL_CONFIG_H

#include <hal/nrf_gpio.h>

#define BLUE_LED      NRF_GPIO_PIN_MAP(0, 17)
#define RED_LED       NRF_GPIO_PIN_MAP(0, 20)
#define TRAFO_L1      NRF_GPIO_PIN_MAP(0, 4)
#define TRAFO_L2      NRF_GPIO_PIN_MAP(0, 5)
#define TRAFO_R1      NRF_GPIO_PIN_MAP(0, 11)
#define TRAFO_R2      NRF_GPIO_PIN_MAP(1, 9)
#define OPAMPS_ON_OFF NRF_GPIO_PIN_MAP(0, 15)
#define LEFT_SENSOR   0
#define RIGHT_SENSOR  1

// this defines the delays after each pulse for changing detection limits
#define SHORT_DISTANCE_MODE_DELAY_US  2000
#define MEDIUM_DISTANCE_MODE_DELAY_US 8000
#define LONG_DISTANCE_MODE_DELAY_US   14000

// this defines the responsiveness towards the received echo signal (maximum = 4096)
// high values used for noisy short range, lower value for weaker long range signals.
// TO DO: optimize thresholds
#define SHORT_DISTANCE_LIMIT_HIGH  3500
#define MEDIUM_DISTANCE_LIMIT_HIGH 3000
#define LONG_DISTANCE_LIMIT_HIGH   2500

// this is used to dynamically find the time it takes for the transducer to decay after an pulse and be able to recieve incoming signals 
// TO DO: not yet implemented!
#define ULTRASONIC_DECAY_LIMIT_LOW 500

#define SAADC_SAMPLINGRATE_US 5    // sample every 5 µs to get the max possible 200 kHz SAADC
#define SAADC_BUF_SIZE        4000 // at 200kHz it takes 20ms to fill the 4000 buffer
#define MAX_MEASUREMENTS      101

#define TIME_TO_SYSTEM_OFF_S 30

#endif
```

## src/nfc.c
```c
#include "nfc.h"

#define MAX_REC_COUNT     1
#define NDEF_MSG_BUF_SIZE 512

LOG_MODULE_REGISTER(nfc);

const uint8_t android_pkg_name[] = {
    'a', 'p', 'p', 'i', 'n', 'v', 'e', 'n', 't', 'o', 'r', '.', 'a', 'i', '_', 'c', 'o', 'r', 'v', 'i', 'n', 'l', 'o', 's', 's', 'i', 'n', '.', 'O', 'B', 'S', 'm', 'i', 'n', 'i', '_', 'A', 'D', 'C'};
// 'c', 'o', 'm', '.', 'e', 'x', 'a', 'm', 'p', 'l', 'e', '.', 'o', 'b', 's', 'm', 'i', 'n', 'i'};

static uint8_t ndef_msg_buf[NDEF_MSG_BUF_SIZE];

void nfc_init(nfc_t2t_callback_t nfc_cb_handler)
{
    size_t ndef_msg_buf_len = sizeof(ndef_msg_buf);

    err = nfc_t2t_setup(nfc_cb_handler, NULL);
    ERR_CHECK(err, "Cannot setup NFC T2T library!");

    err = nfc_launchapp_msg_encode(android_pkg_name,
                                   sizeof(android_pkg_name),
                                   NULL,
                                   0,
                                   ndef_msg_buf,
                                   &ndef_msg_buf_len);
    ERR_CHECK(err, "Cannot encode NFC messages!");

    err = nfc_t2t_payload_set(ndef_msg_buf, ndef_msg_buf_len);
    ERR_CHECK(err, "Cannot set NFC payload");

    err = nfc_t2t_emulation_start();
    ERR_CHECK(err, "Cannot start NFC emulation!");

    LOG_INF("NFC configuration done");
}
```

## src/nfc.h
```c
#ifndef NFC_H
#define NFC_H

#include "error_handling.h"
#include <nfc/ndef/launchapp_msg.h>
#include <nfc_t2t_lib.h>
#include <zephyr/logging/log.h>

void nfc_init(nfc_t2t_callback_t nfc_cb_handler);

#endif
```

## src/pin_config.h
```c
#ifndef PIN_CONFIG_H
#define PIN_CONFIG_H

#include <hal/nrf_gpio.h>

#define BLUE_LED      NRF_GPIO_PIN_MAP(0, 17)
#define RED_LED       NRF_GPIO_PIN_MAP(0, 20)
#define TRAFO_L1      NRF_GPIO_PIN_MAP(0, 4)
#define TRAFO_L2      NRF_GPIO_PIN_MAP(0, 5)
#define TRAFO_R1      NRF_GPIO_PIN_MAP(0, 11)
#define TRAFO_R2      NRF_GPIO_PIN_MAP(1, 9)
#define OPAMPS_ON_OFF NRF_GPIO_PIN_MAP(0, 15)
#define LEFT_SENSOR   0
#define RIGHT_SENSOR  1

#define SAADC_BUF_SIZE        4000 // at 200kHz it takes 20ms to fill the 4000 buffer
#define SAADC_SAMPLINGRATE_US 5    // sample every 5 µs to get the max possible 200 kHz SAADC
#define MAX_MEASUREMENTS      101  // 2 measurements take 20ms

#endif
```

## src/pulse_generator.c
```c
#include "pulse_generator.h"

#define NRFX_PWM_VALUES_LENGTH(array) (sizeof(array) / (sizeof(uint16_t)))
#define PWM_MAX                       25 // must be lower than (2^16)/2 = 32768, 1 as MSB is the problem

LOG_MODULE_REGISTER(pulse_generator);

static const nrfx_pwm_t pwm_for_ultrasonic_pulses_instance = NRFX_PWM_INSTANCE(0);

static const nrfx_pwm_config_t pwm_for_ultrasonic_pulses_peripheral_config = {
    .output_pins = {
        TRAFO_L1,
        TRAFO_R1,
        TRAFO_L2,
        TRAFO_R2},
    .irq_priority  = NRFX_PWM_DEFAULT_CONFIG_IRQ_PRIORITY,
    .base_clock    = NRF_PWM_CLK_2MHz,
    .count_mode    = NRF_PWM_MODE_UP,
    .top_value     = PWM_MAX,
    .load_mode     = NRF_PWM_LOAD_GROUPED,
    .step_mode     = NRF_PWM_STEP_AUTO,
    .skip_gpio_cfg = false};

// nrf_pwm_values_grouped_t arrays cannot be allocated on stack (hence "static")
// and they must be in RAM (hence no "const", though its content is not changed).
// the arrays are subsequently used to generate a pwm sequence, but we only use 0
// and the value of nrfx_pwm_config_t.top_value so we aren't really using the pwm
// functionality but rather use 0% and 100% PWM to generate a given amount of ON/OFF
// pulses. With the ON/OFF time being dependent on the nrfx_pwm_config_t.base_clock
// and .top_value. How the output pins are connected to the elements of
// nrf_pwm_values_grouped_t arrays is defined by .load_mode
static nrf_pwm_values_grouped_t /*const*/ pwm_15plus1pulses[] = {{0, PWM_MAX}, {PWM_MAX, 0}, {0, PWM_MAX}, {PWM_MAX, 0}, {0, PWM_MAX}, {PWM_MAX, 0}, {0, PWM_MAX}, {PWM_MAX, 0}, {0, PWM_MAX}, {PWM_MAX, 0}, {0, PWM_MAX}, {PWM_MAX, 0}, {0, PWM_MAX}, {PWM_MAX, 0}, {0, PWM_MAX}, {PWM_MAX, 0}, {0, PWM_MAX}, {PWM_MAX, 0}, {0, PWM_MAX}, {PWM_MAX, 0}, {0, PWM_MAX}, {PWM_MAX, 0}, {0, PWM_MAX}, {PWM_MAX, 0}, {0, PWM_MAX}, {PWM_MAX, 0}, {0, PWM_MAX}, {PWM_MAX, 0}, {0, PWM_MAX}, {PWM_MAX, 0}, {PWM_MAX, 0}, {0, PWM_MAX}};

static const nrf_pwm_sequence_t pwm_15plus1pulses_seq = {
    .values.p_grouped = pwm_15plus1pulses,
    .length           = NRFX_PWM_VALUES_LENGTH(pwm_15plus1pulses),
    .repeats          = 0,
    .end_delay        = 0};

void pulse_generator_init(void)
{
    nrfx_err = nrfx_pwm_init(&pwm_for_ultrasonic_pulses_instance, &pwm_for_ultrasonic_pulses_peripheral_config, NULL, NULL);
    NRFX_ERR_CHECK(nrfx_err, "Cannot start PWM peripheral")
}

void burst_ultrasonic_pulse_sequence(void)
{
    nrfx_pwm_simple_playback(&pwm_for_ultrasonic_pulses_instance, &pwm_15plus1pulses_seq, 1, NRFX_PWM_FLAG_STOP);
}
```

## src/pulse_generator.h
```c
#ifndef PULSE_GENERATOR_H
#define PULSE_GENERATOR_H

#include "error_handling.h"
#include "global_config.h"
#include <nrfx_pwm.h>
#include <zephyr/logging/log.h>

void pulse_generator_init(void);
void burst_ultrasonic_pulse_sequence(void);

#endif
```

## src/saadc.c
```c
#include "saadc.h"

LOG_MODULE_REGISTER(saadc);

static nrf_saadc_value_t saadc_samples[SAADC_BUF_SIZE];

static const nrfx_saadc_adv_config_t saadc_peripheral_config = {
    .oversampling      = NRF_SAADC_OVERSAMPLE_DISABLED,
    .burst             = NRF_SAADC_BURST_DISABLED,
    .internal_timer_cc = 0,
    .start_on_end      = true};

static const nrfx_saadc_channel_t saadc_left_sensor_channel_config = {
    .channel_config = {
        .resistor_p = NRF_SAADC_RESISTOR_DISABLED,
        .resistor_n = NRF_SAADC_RESISTOR_DISABLED,
        .gain       = NRF_SAADC_GAIN1_2,
        .reference  = NRF_SAADC_REFERENCE_VDD4,
        .acq_time   = NRF_SAADC_ACQTIME_3US,
        .mode       = NRF_SAADC_MODE_SINGLE_ENDED,
        .burst      = NRF_SAADC_BURST_DISABLED},
    .pin_p         = (nrf_saadc_input_t)NRF_SAADC_INPUT_AIN1,
    .pin_n         = NRF_SAADC_INPUT_DISABLED,
    .channel_index = LEFT_SENSOR};

static const nrfx_saadc_channel_t saadc_right_sensor_channel_config = {
    .channel_config = {
        .resistor_p = NRF_SAADC_RESISTOR_DISABLED,
        .resistor_n = NRF_SAADC_RESISTOR_DISABLED,
        .gain       = NRF_SAADC_GAIN1_2,
        .reference  = NRF_SAADC_REFERENCE_VDD4,
        .acq_time   = NRF_SAADC_ACQTIME_3US,
        .mode       = NRF_SAADC_MODE_SINGLE_ENDED,
        .burst      = NRF_SAADC_BURST_DISABLED},
    .pin_p         = (nrf_saadc_input_t)NRF_SAADC_INPUT_AIN4,
    .pin_n         = NRF_SAADC_INPUT_DISABLED,
    .channel_index = RIGHT_SENSOR};

static const nrfx_saadc_channel_t saadc_battery_voltage_channel_config = {
    .channel_config = {
        .resistor_p = NRF_SAADC_RESISTOR_DISABLED,
        .resistor_n = NRF_SAADC_RESISTOR_DISABLED,
        .gain       = NRF_SAADC_GAIN1_2,
        .reference  = NRF_SAADC_REFERENCE_INTERNAL,
        .acq_time   = NRF_SAADC_ACQTIME_40US,
        .mode       = NRF_SAADC_MODE_SINGLE_ENDED,
        .burst      = NRF_SAADC_BURST_DISABLED},
    .pin_p         = (nrf_saadc_input_t)NRF_SAADC_INPUT_VDDHDIV5,
    .pin_n         = NRF_SAADC_INPUT_DISABLED,
    .channel_index = 2};

void saadc_init(nrfx_saadc_event_handler_t saadc_event_handler)
{
    IRQ_CONNECT(SAADC_IRQn, IRQ_PRIO_LOWEST, nrfx_saadc_irq_handler, NULL, 0);

    nrfx_err = nrfx_saadc_init(NRFX_SAADC_DEFAULT_CONFIG_IRQ_PRIORITY);
    NRFX_ERR_CHECK(nrfx_err, "initializing SAADC peripheral failed");

    nrfx_err = nrfx_saadc_offset_calibrate(NULL);
    NRFX_ERR_CHECK(nrfx_err, "Cannot calibrate SAADC")

    nrfx_err = nrfx_saadc_channel_config(&saadc_left_sensor_channel_config);
    nrfx_err = nrfx_saadc_channel_config(&saadc_right_sensor_channel_config);
    NRFX_ERR_CHECK(nrfx_err, "Configuring SAADC channels failed");

    nrfx_err = nrfx_saadc_advanced_mode_set(nrfx_saadc_channels_configured_get(),
                                            NRF_SAADC_RESOLUTION_12BIT,
                                            &saadc_peripheral_config,
                                            saadc_event_handler);
    NRFX_ERR_CHECK(nrfx_err, "setting SAADC mode failed");

    nrfx_err = nrfx_saadc_buffer_set(&saadc_samples[0], SAADC_BUF_SIZE);
    NRFX_ERR_CHECK(nrfx_err, "setting SAADC buffer failed failed");

    nrfx_err = nrfx_saadc_mode_trigger();
    NRFX_ERR_CHECK(nrfx_err, "triggering SAADC mode failed");
}

int16_t get_battery_voltage_mV(nrfx_saadc_event_handler_t saadc_event_handler)
{
    // reinitialize SAADC for single VDDH (battery voltage) conversion in blocking mode
    nrfx_saadc_uninit();

    nrfx_err = nrfx_saadc_init(NRFX_SAADC_DEFAULT_CONFIG_IRQ_PRIORITY);
    NRFX_ERR_CHECK(nrfx_err, "initializing SAADC peripheral failed");

    nrfx_err = nrfx_saadc_offset_calibrate(NULL);
    NRFX_ERR_CHECK(nrfx_err, "Cannot calibrate SAADC")

    nrfx_err = nrfx_saadc_channel_config(&saadc_battery_voltage_channel_config);
    NRFX_ERR_CHECK(nrfx_err, "Configuring SAADC channels failed");

    nrfx_err = nrfx_saadc_simple_mode_set(nrfx_saadc_channels_configured_get(),
                                          NRF_SAADC_RESOLUTION_12BIT,
                                          NRF_SAADC_OVERSAMPLE_DISABLED,
                                          NULL);
    NRFX_ERR_CHECK(nrfx_err, "setting SAADC mode failed");

    nrfx_err = nrfx_saadc_buffer_set(&saadc_samples[0], 1);
    NRFX_ERR_CHECK(nrfx_err, "setting SAADC buffer failed failed");

    nrfx_err = nrfx_saadc_mode_trigger();
    NRFX_ERR_CHECK(nrfx_err, "triggering SAADC mode failed");

    // reinitialize SAADC for continous PPI triggered conversions
    nrfx_saadc_uninit();
    saadc_init(saadc_event_handler);

    // 1.465 results from combining NRF_SAADC_RESOLUTION_12BIT, NRF_SAADC_GAIN1_2, NRF_SAADC_REFERENCE_INTERNAL and NRF_SAADC_INPUT_VDDHDIV5
    return (saadc_samples[0] * 1.465);
}

void saadc_buffer_set(void)
{
    nrfx_err = nrfx_saadc_buffer_set(&saadc_samples[0], SAADC_BUF_SIZE);
    NRFX_ERR_CHECK(nrfx_err, " failed");
}
```

## src/saadc.h
```c
#ifndef SAADC_H
#define SAADC_H

#include "error_handling.h"
#include <nrfx_saadc.h>
#include <zephyr/logging/log.h>

void saadc_init(nrfx_saadc_event_handler_t saadc_event_handler);
int16_t get_battery_voltage_mV(nrfx_saadc_event_handler_t saadc_event_handler);
void saadc_buffer_set(void);

#endif
```
